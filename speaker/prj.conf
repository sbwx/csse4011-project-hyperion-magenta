## prj.conf
```kconfig
CONFIG_I2S=y
CONFIG_I2S_NRFX=y
CONFIG_LOG=y
CONFIG_MAIN_STACK_SIZE=2048
```

## boards/nrf52840dk_nrf52840.overlay
```dts
/*
 * Copyright (c) 2021 Nordic Semiconductor ASA
 *
 * SPDX-License-Identifier: Apache-2.0
 */

&pinctrl {
	i2s0_default_alt: i2s0_default_alt {
		group1 {
			psels = <NRF_PSEL(I2S_SCK_M, 1, 15)>,
				<NRF_PSEL(I2S_LRCK_M, 1, 12)>,
				<NRF_PSEL(I2S_SDOUT, 1, 13)>,
				<NRF_PSEL(I2S_SDIN, 1, 14)>;
		};
	};
};

i2s_rxtx: &i2s0 {
	status = "okay";
	pinctrl-0 = <&i2s0_default_alt>;
	pinctrl-names = "default";
};
```

## src/main.c
```c
#include <zephyr/kernel.h>
#include <zephyr/sys/printk.h>
#include <zephyr/drivers/i2s.h>
#include <zephyr/logging/log.h>
#include <math.h>
#include <string.h>

#include "tones.h"
#include "imperial_march.h"

LOG_MODULE_REGISTER(i2s_playback, LOG_LEVEL_DBG);

/* Audio settings */
#define SAMPLE_RATE         44100
#define CHANNELS            2
#define BITS_PER_SAMPLE     16
#define BYTES_PER_SAMPLE    (BITS_PER_SAMPLE / 8)
#define BLOCK_SAMPLES       256
#define BLOCK_SIZE          (BLOCK_SAMPLES * CHANNELS * BYTES_PER_SAMPLE)

K_MEM_SLAB_DEFINE_STATIC(mem_slab, BLOCK_SIZE, 4, 4);

static const struct device *i2s_dev;

static void generate_square_wave(int16_t *buffer, size_t samples, float frequency, int16_t amplitude) {
    if (frequency == 0.0f) {
        // Generate silence
        memset(buffer, 0, samples * CHANNELS * BYTES_PER_SAMPLE);
        return;
    }

    static int toggle = 0;
    int samples_per_half_wave = SAMPLE_RATE / (2 * frequency);
    int count = 0;

    for (size_t i = 0; i < samples; i++) {
        if (count++ >= samples_per_half_wave) {
            toggle = !toggle;
            count = 0;
        }

        int16_t val = toggle ? amplitude : -amplitude;
        buffer[2 * i] = val;     // Left
        buffer[2 * i + 1] = val; // Right
    }
}

// Function to play one note at specified duration and amplitude
static void play_tone(struct tone note, int16_t amplitude) {
    uint32_t total_samples = (SAMPLE_RATE * note.duration_ms) / 1000;
    uint32_t blocks_needed = (total_samples + BLOCK_SAMPLES - 1) / BLOCK_SAMPLES;

    for (uint32_t i = 0; i < blocks_needed; i++) {
        void *block;
        if (k_mem_slab_alloc(&mem_slab, &block, K_FOREVER) == 0) {
            generate_square_wave(block, BLOCK_SAMPLES, note.frequency, amplitude);
            i2s_write(i2s_dev, block, BLOCK_SIZE);
        }
    }
}

/* Play a melody from an array of tones */
static void play_melody(const struct tone* melody, size_t len, int16_t amplitude) {
    for (size_t i = 0; i < len; i++) {
        play_tone(melody[i], amplitude);
    }
}

int main(void) {
    printk("I2S melody playback\n");

    i2s_dev = DEVICE_DT_GET(DT_NODELABEL(i2s0));
    if (!device_is_ready(i2s_dev)) {
        printk("I2S device not ready\n");
        return -1;
    }

    struct i2s_config config = {
        .word_size = BITS_PER_SAMPLE,
        .channels = CHANNELS,
        .format = I2S_FMT_DATA_FORMAT_I2S,
        .options = I2S_OPT_BIT_CLK_MASTER | I2S_OPT_FRAME_CLK_MASTER,
        .frame_clk_freq = SAMPLE_RATE,
        .block_size = BLOCK_SIZE,
        .mem_slab = &mem_slab,
        .timeout = 1000,
    };

    if (i2s_configure(i2s_dev, I2S_DIR_TX, &config) < 0) {
        printk("Failed to configure I2S TX\n");
        return -1;
    }

    if (i2s_trigger(i2s_dev, I2S_DIR_TX, I2S_TRIGGER_START) < 0) {
        printk("Failed to start I2S TX\n");
        return -1;
    }

    printk("Playing melody...\n");

    play_melody(imperial_march, ARRAY_SIZE(imperial_march), 1000);

    struct tone test = {NOTE_F4, 350};

    return 0;
}
```

## src/imperial_march.h
```c
#ifndef IMPERIAL_MARCH
#define IMPERIAL_MARCH

#include "tones.h"

struct tone imperial_march[] = {
    {NOTE_A4, 500}, 
    {PAUSE, 1}, 
    {NOTE_A4, 500}, 
    {PAUSE, 1}, 
    {NOTE_A4, 500}, 
    {NOTE_F4, 350}, {NOTE_C5, 150}, {NOTE_A4, 500}, 
    {NOTE_F4, 350}, {NOTE_C5, 150}, {NOTE_A4, 1000},

    {NOTE_E5, 500}, 
    {PAUSE, 1}, 
    {NOTE_E5, 500}, 
    {PAUSE, 1}, 
    {NOTE_E5, 500},
    {NOTE_F5, 350}, {NOTE_C5, 150}, {NOTE_GS4, 500}, 
    {NOTE_F4, 350}, {NOTE_C5, 150}, {NOTE_A4, 1000},

    {NOTE_A5, 500}, {NOTE_A4, 350}, {NOTE_A4, 150}, {NOTE_A5, 500},
    {NOTE_GS5, 250}, {NOTE_G5, 250}, {NOTE_FS5, 125}, {NOTE_F5, 125}, {NOTE_FS5, 250},

    {PAUSE, 250}, {NOTE_AS4, 250}, {NOTE_DS5, 500}, {NOTE_D5, 250}, {NOTE_CS5, 250},
    {NOTE_C5, 125}, {NOTE_B4, 125}, {NOTE_C5, 250},

    {PAUSE, 250}, {NOTE_F4, 250}, {NOTE_GS4, 500}, {NOTE_F4, 375}, {NOTE_A4, 125},
    {NOTE_C5, 500}, {NOTE_A4, 375}, {NOTE_C5, 125}, {NOTE_E5, 1000}, 

    {NOTE_A5, 500}, {NOTE_A4, 350}, {NOTE_A4, 150}, {NOTE_A5, 500},
    {NOTE_GS5, 250}, {NOTE_G5, 250}, {NOTE_FS5, 125}, {NOTE_F5, 125}, {NOTE_FS5, 250},

    {PAUSE, 250}, {NOTE_AS4, 250}, {NOTE_DS5, 500}, {NOTE_D5, 250}, {NOTE_CS5, 250},
    {NOTE_C5, 125}, {NOTE_B4, 125}, {NOTE_C5, 250},

    {PAUSE, 250}, {NOTE_F4, 250}, {NOTE_GS4, 500}, 

    {NOTE_F4, 350}, {NOTE_C5, 150}, {NOTE_A4, 500}, 
    {NOTE_F4, 350}, {NOTE_C5, 150}, {NOTE_A4, 1000},

    {PAUSE, 500}
};

#endif
```

## src/tones.h
```c
#ifndef TONES
#define TONES

/* Tone definition */
struct tone {
    float frequency;      // Frequency in Hz
    uint32_t duration_ms; // Duration in milliseconds
};

/* Note frequencies (Hz) */
#define NOTE_C0   16.35f
#define NOTE_CS0  17.32f  // C#0 / Db0
#define NOTE_D0   18.35f
#define NOTE_DS0  19.45f
#define NOTE_E0   20.60f
#define NOTE_F0   21.83f
#define NOTE_FS0  23.12f
#define NOTE_G0   24.50f
#define NOTE_GS0  25.96f
#define NOTE_A0   27.50f
#define NOTE_AS0  29.14f
#define NOTE_B0   30.87f

#define NOTE_C1   32.70f
#define NOTE_CS1  34.65f
#define NOTE_D1   36.71f
#define NOTE_DS1  38.89f
#define NOTE_E1   41.20f
#define NOTE_F1   43.65f
#define NOTE_FS1  46.25f
#define NOTE_G1   49.00f
#define NOTE_GS1  51.91f
#define NOTE_A1   55.00f
#define NOTE_AS1  58.27f
#define NOTE_B1   61.74f

#define NOTE_C2   65.41f
#define NOTE_CS2  69.30f
#define NOTE_D2   73.42f
#define NOTE_DS2  77.78f
#define NOTE_E2   82.41f
#define NOTE_F2   87.31f
#define NOTE_FS2  92.50f
#define NOTE_G2   98.00f
#define NOTE_GS2  103.83f
#define NOTE_A2   110.00f
#define NOTE_AS2  116.54f
#define NOTE_B2   123.47f

#define NOTE_C3   130.81f
#define NOTE_CS3  138.59f
#define NOTE_D3   146.83f
#define NOTE_DS3  155.56f
#define NOTE_E3   164.81f
#define NOTE_F3   174.61f
#define NOTE_FS3  185.00f
#define NOTE_G3   196.00f
#define NOTE_GS3  207.65f
#define NOTE_A3   220.00f
#define NOTE_AS3  233.08f
#define NOTE_B3   246.94f

#define NOTE_C4   261.63f
#define NOTE_CS4  277.18f
#define NOTE_D4   293.66f
#define NOTE_DS4  311.13f
#define NOTE_E4   329.63f
#define NOTE_F4   349.23f
#define NOTE_FS4  369.99f
#define NOTE_G4   392.00f
#define NOTE_GS4  415.30f
#define NOTE_A4   440.00f
#define NOTE_AS4  466.16f
#define NOTE_B4   493.88f

#define NOTE_C5   523.25f
#define NOTE_CS5  554.37f
#define NOTE_D5   587.33f
#define NOTE_DS5  622.25f
#define NOTE_E5   659.26f
#define NOTE_F5   698.46f
#define NOTE_FS5  739.99f
#define NOTE_G5   783.99f
#define NOTE_GS5  830.61f
#define NOTE_A5   880.00f
#define NOTE_AS5  932.33f
#define NOTE_B5   987.77f

#define NOTE_C6   1046.50f
#define NOTE_CS6  1108.73f
#define NOTE_D6   1174.66f
#define NOTE_DS6  1244.51f
#define NOTE_E6   1318.51f
#define NOTE_F6   1396.91f
#define NOTE_FS6  1479.98f
#define NOTE_G6   1567.98f
#define NOTE_GS6  1661.22f
#define NOTE_A6   1760.00f
#define NOTE_AS6  1864.66f
#define NOTE_B6   1975.53f

#define NOTE_C7   2093.00f
#define NOTE_CS7  2217.46f
#define NOTE_D7   2349.32f
#define NOTE_DS7  2489.02f
#define NOTE_E7   2637.02f
#define NOTE_F7   2793.83f
#define NOTE_FS7  2959.96f
#define NOTE_G7   3135.96f
#define NOTE_GS7  3322.44f
#define NOTE_A7   3520.00f
#define NOTE_AS7  3729.31f
#define NOTE_B7   3951.07f
#define PAUSE     0.1f

#endif
```
